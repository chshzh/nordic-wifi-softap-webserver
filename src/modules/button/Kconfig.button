## src/modules/button/Kconfig.button
```kconfig
#
# Copyright (c) 2026 Nordic Semiconductor ASA
#
# SPDX-License-Identifier: LicenseRef-Nordic-5-Clause
#

config BUTTON_MODULE
	bool "Button Module"
	default y
	help
	  Enable button monitoring module with SMF state machine

if BUTTON_MODULE

module = BUTTON_MODULE
module-str = button_module
source "subsys/logging/Kconfig.template.log_config"

config BUTTON_DEBOUNCE_MS
	int "Button debounce time in milliseconds"
	default 50
	help
	  Debounce time for button press detection

endif # BUTTON_MODULE
```

## src/modules/led/Kconfig.led
```kconfig
#
# Copyright (c) 2026 Nordic Semiconductor ASA
#
# SPDX-License-Identifier: LicenseRef-Nordic-5-Clause
#

config LED_MODULE
	bool "LED Module"
	default y
	help
	  Enable LED control module with SMF state machine

if LED_MODULE

module = LED_MODULE
module-str = led_module
source "subsys/logging/Kconfig.template.log_config"

endif # LED_MODULE
```

## src/modules/network/Kconfig.network
```kconfig
# Network module Kconfig

config NETWORK_MODULE
	bool "Network event management module"
	default y
	help
	  Enable network event management module for handling
	  network interface events, WiFi SoftAP events, and
	  station connection tracking.

choice NETWORK_MODULE_LOG_LEVEL_CHOICE
	prompt "Network module log level"
	default NETWORK_MODULE_LOG_LEVEL_INF

config NETWORK_MODULE_LOG_LEVEL_OFF
	bool "Off"

config NETWORK_MODULE_LOG_LEVEL_ERR
	bool "Error"

config NETWORK_MODULE_LOG_LEVEL_WRN
	bool "Warning"

config NETWORK_MODULE_LOG_LEVEL_INF
	bool "Info"

config NETWORK_MODULE_LOG_LEVEL_DBG
	bool "Debug"

endchoice

config NETWORK_MODULE_LOG_LEVEL
	int
	default 0 if NETWORK_MODULE_LOG_LEVEL_OFF
	default 1 if NETWORK_MODULE_LOG_LEVEL_ERR
	default 2 if NETWORK_MODULE_LOG_LEVEL_WRN
	default 3 if NETWORK_MODULE_LOG_LEVEL_INF
	default 4 if NETWORK_MODULE_LOG_LEVEL_DBG
```

## src/modules/webserver/Kconfig.webserver
```kconfig
#
# Copyright (c) 2026 Nordic Semiconductor ASA
#
# SPDX-License-Identifier: LicenseRef-Nordic-5-Clause
#

config WEBSERVER_MODULE
	bool "Webserver Module"
	default y
	help
	  Enable HTTP webserver module

if WEBSERVER_MODULE

module = WEBSERVER_MODULE
module-str = webserver_module
source "subsys/logging/Kconfig.template.log_config"

endif # WEBSERVER_MODULE
```

## src/modules/wifi/Kconfig.wifi
```kconfig
#
# Copyright (c) 2026 Nordic Semiconductor ASA
#
# SPDX-License-Identifier: LicenseRef-Nordic-5-Clause
#

config WIFI_MODULE
	bool "WiFi Module"
	default y
	help
	  Enable WiFi SoftAP module with SMF state machine

if WIFI_MODULE

module = WIFI_MODULE
module-str = wifi_module
source "subsys/logging/Kconfig.template.log_config"

endif # WIFI_MODULE
```
